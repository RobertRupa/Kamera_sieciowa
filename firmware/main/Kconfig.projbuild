## firmware/main/Kconfig.projbuild
```kconfig
menu "Camera Hub"

config APP_BOARD_WAVESHARE_P4_C6_SDIO
    bool "Waveshare ESP32-P4 + ESP32-C6 (SDIO coprocessor)"
    depends on IDF_TARGET_ESP32P4
    default y
    help
        ESP32-P4 is the only application build/flash target. ESP32-C6 is an
        onboard Wi-Fi/BLE coprocessor running independently, connected by
        the existing 4-bit SDIO and ESP-Hosted configuration. This board
        identity does not flash or reconfigure the C6.


config APP_DEV_MODE
    bool "Development diagnostic firmware"
    default y
    help
        Camera and network startup remain blocked until hardware/security verification.
        Disable for release.

config APP_CAMERA_OV5647_DRIVER
    bool "Compile OV5647 MIPI-CSI sensor driver"
    depends on ESP_VIDEO_ENABLE_MIPI_CSI_VIDEO_DEVICE
    default y
    select CAMERA_OV5647
    help
        Build Espressif's OV5647 driver. Sensor detection and the one-frame
        development probe are controlled separately by APP_CAMERA_PROBE_ON_BOOT.

config APP_USB_UVC_ENABLE
    bool "Enable ESP32-P4 USB 2.0 HS MJPEG webcam (UVC device)"
    depends on APP_CAMERA_OV5647_DRIVER && IDF_TARGET_ESP32P4
    default y
    help
        Requires verified OTG device jumper and connector VBUS routing.
        USB webcam enumeration is independent of Wi-Fi or the setup AP.

config APP_CAMERA_PROBE_ON_BOOT
    bool "Run a one-frame MIPI-CSI hardware probe at boot"
    depends on APP_DEV_MODE && APP_CAMERA_OV5647_DRIVER
    default y if APP_DEV_MODE
    help
        Uses the Waveshare Platform shared I2C bus (I2C_NUM_0, SDA 7, SCL 8)
        and Espressif esp_video to identify a supported OV5647 and capture one
        bounded frame. It uses no reset/PWDN/XCLK GPIO and stops capture before
        network startup. A successful probe enables the development preview. Unsupported
        sensors or an unpowered camera are reported as no supported sensor.

config APP_DEV_DEFAULT_CREDENTIALS
    bool "Permit insecure development defaults"
    depends on APP_DEV_MODE
    default n
    help
        Enable local camera configuration login with admin/admin. The UI shows
        an insecure-development warning. Never enable this in release firmware.

config APP_WIFI_WIRING_VERIFIED
    bool "C6 transport pinout matches this board and configured ESP-Hosted transport"
    default n
    help
        Enable only after checking the actual schematic and ESP-Hosted bus configuration.

config APP_C6_TRANSPORT_PROBE
    bool "Read-only C6 handshake/identity probe (no AP/STA or credentials)"
    depends on APP_DEV_MODE && APP_WIFI_WIRING_VERIFIED
    default n

config APP_C6_STORAGE_AUDITED
    bool "C6 Wi-Fi driver NVS is disabled; credentials persist only on P4"
    default n
    help
        The matching ESP-Hosted companion must honor nvs_enable=0 during Wi-Fi initialization.

config APP_DEV_OPEN_SETUP_AP
    bool "Authorize local development open provisioning AP"
    depends on APP_DEV_MODE
    default n
    help
        Local laboratory only. No release activation or public deployment.

endmenu
```

## firmware/sdkconfig.defaults
```kconfig
CONFIG_PARTITION_TABLE_CUSTOM=y
CONFIG_PARTITION_TABLE_CUSTOM_FILENAME="partitions.csv"
CONFIG_ESPTOOLPY_FLASHSIZE_16MB=y
CONFIG_ESP32P4_SELECTS_REV_LESS_V3=y
CONFIG_ESP32P4_REV_MIN_100=y
CONFIG_ESP_DEFAULT_CPU_FREQ_MHZ_360=y
CONFIG_ESP_CONSOLE_UART_DEFAULT=y
CONFIG_ESP_CONSOLE_SECONDARY_USB_SERIAL_JTAG=y
CONFIG_APP_DEV_MODE=y
CONFIG_APP_DEV_DEFAULT_CREDENTIALS=n
CONFIG_APP_C6_STORAGE_AUDITED=y
CONFIG_ESP_HOSTED_AUTO_CALL_INIT_BEFORE_APP_MAIN=n
CONFIG_CJSON_NESTING_LIMIT=4
CONFIG_CJSON_CIRCULAR_LIMIT=8
CONFIG_ESP_HOSTED_HOST_TRANSPORT_BUS_SDIO=y
CONFIG_ESP_HOSTED_SDIO_SLOT_1=y
CONFIG_ESP_HOSTED_HOST_SDIO_BUS_WIDTH_4=y
CONFIG_ESP_HOSTED_HOST_SDIO_PIN_CMD=19
CONFIG_ESP_HOSTED_HOST_SDIO_PIN_CLK=18
CONFIG_ESP_HOSTED_HOST_SDIO_PIN_D0=14
CONFIG_ESP_HOSTED_HOST_SDIO_PIN_D1=15
CONFIG_ESP_HOSTED_HOST_SDIO_PIN_D2=16
CONFIG_ESP_HOSTED_HOST_SDIO_PIN_D3=17
CONFIG_ESP_HOSTED_HOST_RESET_GPIO=54
```

## migration/host_legacy/sdkconfig.defaults
```kconfig
CONFIG_ESP32P4_SELECTS_REV_LESS_V3=y
CONFIG_ESP32P4_REV_MIN_100=y
CONFIG_ESP_DEFAULT_CPU_FREQ_MHZ_360=y
CONFIG_ESP_CONSOLE_UART_DEFAULT=y
CONFIG_ESP_CONSOLE_SECONDARY_USB_SERIAL_JTAG=y
CONFIG_ESPTOOLPY_FLASHSIZE_16MB=y
CONFIG_PARTITION_TABLE_CUSTOM=y
CONFIG_PARTITION_TABLE_CUSTOM_FILENAME="../../firmware/partitions.csv"
CONFIG_ESP_HOSTED_AUTO_CALL_INIT_BEFORE_APP_MAIN=n
```

## migration/radio_c6/sdkconfig.defaults
```kconfig
CONFIG_ESP_HOSTED=y
CONFIG_ESP_HOSTED_CP=y
CONFIG_ESP_HOSTED_CP_FOR_MCU=y
CONFIG_ESP_HOSTED_CP_RPC_V2=y
CONFIG_ESP_HOSTED_CP_FEAT_WIFI=y
CONFIG_ESP_WIFI_ENABLED=y
CONFIG_ESP_WIFI_NVS_ENABLED=n
CONFIG_BT_ENABLED=n
CONFIG_ESPTOOLPY_FLASHSIZE_4MB=y
CONFIG_PARTITION_TABLE_CUSTOM=y
CONFIG_PARTITION_TABLE_CUSTOM_FILENAME="partitions.csv"
CONFIG_FREERTOS_HZ=1000
CONFIG_SECURE_BOOT=n
CONFIG_SECURE_FLASH_ENC_ENABLED=n
```

## sdkconfig.defaults
```kconfig
CONFIG_LWIP_MAX_SOCKETS=16
CONFIG_PARTITION_TABLE_CUSTOM=y
CONFIG_PARTITION_TABLE_CUSTOM_FILENAME="firmware/partitions.csv"
CONFIG_ESPTOOLPY_FLASHSIZE_16MB=y
CONFIG_ESP32P4_SELECTS_REV_LESS_V3=y
CONFIG_ESP32P4_REV_MIN_100=y
CONFIG_ESP_DEFAULT_CPU_FREQ_MHZ_360=y
CONFIG_IDF_EXPERIMENTAL_FEATURES=y
CONFIG_SPIRAM=y
CONFIG_SPIRAM_SPEED_200M=y
CONFIG_CAMERA_OV5647_MIPI_RAW8_800X640_50FPS=y
CONFIG_CAMERA_OV5647_MIPI_RAW8_800X800_50FPS=y
CONFIG_CAMERA_OV5647_MIPI_RAW8_800X1280_50FPS=y
CONFIG_CAMERA_OV5647_MIPI_RAW10_1920X1080_30FPS=y
CONFIG_CAMERA_OV5647_MIPI_RAW10_1280X960_BINNING_45FPS=y
CONFIG_ESP_CONSOLE_UART_DEFAULT=y
CONFIG_ESP_CONSOLE_SECONDARY_USB_SERIAL_JTAG=y
CONFIG_APP_DEV_MODE=y
CONFIG_ESP_MAIN_TASK_STACK_SIZE=8192
CONFIG_APP_DEV_DEFAULT_CREDENTIALS=n
# Development AP is only authorized through the default CMake preset:
# sdkconfig.dev.defaults. The production preset does not enable it.
CONFIG_APP_C6_STORAGE_AUDITED=y
CONFIG_ESP_HOSTED_AUTO_CALL_INIT_BEFORE_APP_MAIN=n
CONFIG_CJSON_NESTING_LIMIT=4
CONFIG_CJSON_CIRCULAR_LIMIT=8
CONFIG_ESP_HOSTED_HOST_TRANSPORT_BUS_SDIO=y
CONFIG_ESP_HOSTED_SDIO_SLOT_1=y
CONFIG_ESP_HOSTED_HOST_SDIO_BUS_WIDTH_4=y
CONFIG_ESP_HOSTED_HOST_SDIO_PIN_CMD=19
CONFIG_ESP_HOSTED_HOST_SDIO_PIN_CLK=18
CONFIG_ESP_HOSTED_HOST_SDIO_PIN_D0=14
CONFIG_ESP_HOSTED_HOST_SDIO_PIN_D1=15
CONFIG_ESP_HOSTED_HOST_SDIO_PIN_D2=16
CONFIG_ESP_HOSTED_HOST_SDIO_PIN_D3=17
CONFIG_ESP_HOSTED_HOST_RESET_GPIO=54
# UVC MJPEG on the dedicated ESP32-P4 USB 2.0 High-Speed OTG device controller.
# Use the OTG device-role jumper; do not connect two USB hosts.
CONFIG_APP_USB_UVC_ENABLE=y
CONFIG_TINYUSB_RHPORT_HS=y
CONFIG_FORMAT_MJPEG_CAM1=y
CONFIG_UVC_MODE_BULK_CAM1=y
CONFIG_UVC_SUPPORT_TWO_CAM=n
CONFIG_UVC_CAM1_MULTI_FRAMESIZE=y
CONFIG_FRAMESIZE_SVGA=y
CONFIG_UVC_CAM1_FRAMESIZE_WIDTH=800
CONFIG_UVC_CAM1_FRAMESIZE_HEIGT=800
CONFIG_UVC_CAM1_FRAMERATE=50
CONFIG_UVC_MULTI_FRAME_WIDTH_1=800
CONFIG_UVC_MULTI_FRAME_HEIGHT_1=640
CONFIG_UVC_MULTI_FRAME_FPS_1=50
CONFIG_UVC_MULTI_FRAME_WIDTH_2=1280
CONFIG_UVC_MULTI_FRAME_HEIGHT_2=960
CONFIG_UVC_MULTI_FRAME_FPS_2=45
CONFIG_UVC_MULTI_FRAME_WIDTH_3=1920
CONFIG_UVC_MULTI_FRAME_HEIGHT_3=1080
CONFIG_UVC_MULTI_FRAME_FPS_3=30
CONFIG_TUSB_MANUFACTURER="Camera Hub"
CONFIG_TUSB_PRODUCT="ESP32-P4 OV5647 UVC"

CONFIG_IDF_TARGET="esp32p4"
```

## templates/esp-idf/main/Kconfig.projbuild
```kconfig
menu "Application profile"

config APP_DEV_MODE
    bool "Development / local laboratory firmware"
    default y
    help
        Development diagnostics are permitted. Disable in release.

config APP_DEV_DEFAULT_CREDENTIALS
    bool "Allow admin/admin default WebGUI login (INSECURE)"
    depends on APP_DEV_MODE
    default y
    help
        For explicitly local test firmware only. Authentication module must
        reject default credentials when APP_DEV_MODE is disabled.

endmenu
```
